## main/Kconfig.probuild
```kconfig
menu "Project Configuration"

    config ESP_WIFI_SSID
        string "Wifi SSID"
        default "myssid"
        help
            SSID (network name) for the esp32 connect to.
    
    config ESP_WIFI_PASSWORD
        string "Wifi Password"
        default "mypassword"
        help
            Wifi password (WPA or WPA2) for the esp32 to use.
    
    config ESP_WIFI_CHANNEL
        int "Wifi Channel"
        range 1 13
        default 1
        help
            Wifi channel (netword channel) for the esp32 to use.

    config ESP_MAX_STA_CONN
        int "Maximal STA Connection"
        default 5
        help
            Max number of the STA connects to AP.

endmenu
```
